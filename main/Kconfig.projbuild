## main/Kconfig.projbuild
```kconfig
menu "GreenField (AgTech4All Project)"    

    config ATL_LED_BUILTIN_GPIO
        int "LED builtin GPIO number"
        range 0 48
        default 5 if IDF_TARGET_ESP32
        default 18 if IDF_TARGET_ESP32S2
        default 48 if IDF_TARGET_ESP32S3
        default 8
        help
            GPIO number (IOxx) to LED builtin.

    config ATL_LED_BUILTIN_PERIOD
        int "LED builtin period (in ms)"
        range 100 3600000
        default 2000
        help
            Define the LED builtin blinking period in milliseconds.

    config ATL_BUTTON_GPIO
        int "Button GPIO number"
        range 0 48              
        default 0
        help
            GPIO number (IOxx) to button.            
    
    menu "WiFi Configuration"
        config ATL_WIFI_AP_SSID_PREFIX
            string "WiFi AP SSID prefix"
            default "AgTech4All-"
            help
                WiFi AP SSID (network name) prefix (max. 25).
                
        config ATL_WIFI_AP_PASSWORD
            string "WiFi AP Password"
            default "AgTech4All"
            help
                WiFi AP password.
        
        config ATL_WIFI_AP_CHANNEL
            int "WiFi AP channel"
            range 1 11
            default 6
            help
                WiFi AP channel.
        
        config ATL_WIFI_AP_MAX_STA_CONN
            int "WiFi AP maximum client simultanous"
            default 4
            help
                Maximum clientes connected simultanous at AP.
                
        config ATL_WIFI_STA_MAX_CONN_RETRY
            int "WiFi AP maximum client simultanous"
            default 5
            help
                Maximum STA connection retry.
    endmenu

    menu "Webserver Configuration"
        config ATL_WEBSERVER_ADMIN_USER
            string "Webserver administrator user"
            default "admin"
            help
                Default administrator user at GreenField webserver.
            
        config ATL_WEBSERVER_ADMIN_PASS
            string "Webserver administrator password"
            default "AgTech4All"
            help
                Default administrator password at GreenField webserver.        
    endmenu

    menu "MQTT client Configuration"
        config ATL_MQTT_BROKER_ADDR
            string "MQTT broker address"
            default "agrotechlab.lages.ifsc.edu.br"
            help
                Default broker address.
            
        config ATL_MQTT_BROKER_PORT
            int "MQTT broker port"
            range 1 65535
            default 8883
            help
                Default broker port.
        
        config ATL_MQTT_QOS
            int "MQTT QoS"
            range 0 2
            default 0
            help
                Default QoS.
    endmenu
endmenu
```
